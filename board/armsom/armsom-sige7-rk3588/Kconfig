## board/armsom/armsom-sige7-rk3588/Kconfig
```kconfig
if TARGET_ARMSOM_SIGE7_RK3588

config SYS_BOARD
	default "armsom-sige7-rk3588"

config SYS_VENDOR
	default "armsom"

config SYS_CONFIG_NAME
	default "armsom-sige7-rk3588"

config BOARD_SPECIFIC_OPTIONS # dummy
	def_bool y

endif
```
