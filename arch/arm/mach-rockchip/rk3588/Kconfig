## arch/arm/mach-rockchip/rk3588/Kconfig
```kconfig
if ROCKCHIP_RK3588

config TARGET_EVB_RK3588
	bool "EVB_RK3588"
	select BOARD_LATE_INIT
	help
	  RK3588 EVB is a evaluation board for Rockchp RK3588.

config TARGET_ROC_RK3588S_PC
	bool "ROC_RK3588S_PC"
	select BOARD_LATE_INIT
	help
	  ROC_RK3588S_PC is a RK3588S-based board with 3 USB ports(1 TypeC port),
	  HDMI, DP, micro-SD card, audio, M.2 PCIE/SATA, WiFi  and Gigabit Ethernet,
	  It also includes on-board eMMC and LPDDR4. Expansion connectors
	  provide access to display pins, MIPI-CSI/DSI, I2C, SPI, UART and GPIOs.

config SYS_SOC
	default "rockchip"

config SYS_MALLOC_F_LEN
	default 0x400

source board/rockchip/evb_rk3588/Kconfig
source board/firefly/roc-rk3588s-pc/Kconfig

endif
```

## board/firefly/roc-rk3588s-pc/Kconfig
```kconfig
if TARGET_ROC_RK3588S_PC

config SYS_BOARD
	default "roc-rk3588s-pc"

config SYS_VENDOR
	default "firefly"

config SYS_CONFIG_NAME
	default "roc-rk3588s-pc"

config BOARD_SPECIFIC_OPTIONS # dummy
	def_bool y

endif
```
